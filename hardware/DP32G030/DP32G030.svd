# DP32G030 register map
File version: 1.0
CPU: CM0 r0p0, little endian, 4 interrupt priority bits
Registers are 32-bit, access not given, reset 0x0 unless marked. A register's access mark holds for its fields unless they carry their own. Offsets are from the block's base; lines under a group give offsets from that group; [hi:lo] are bit positions; {n}, {i} and the like mark numbered series; 'fields as' and 'values as' point back to an identical list; <NAME> marks a mode.

## Memory map
0x40000000 SYSCON size 0x800 — System Configuration unit
0x40000800 PMU size 0x800 — Power management unit
0x40001000 DMA size 0x800 — DMA unit
0x40003000 CRC size 0x800 — Cyclic redundancy check calculation unit
0x40060000 GPIOA size 0x800 — GPIOA unit
0x40060800 GPIOB size 0x800 — GPIOB unit
0x40061000 GPIOC size 0x800 — GPIOC unit
0x40064000 TIMER_BASE0 size 0x800 — TIMER_BASE0 unit
0x40064800 TIMER_BASE1 size 0x800 — TIMER_BASE1 unit
0x40065000 TIMER_BASE2 size 0x800 — TIMER_BASE2 unit
0x40067000 TIMER_PLUS0 size 0x800 — TIMER_PLUS0 unit
0x40067800 TIMER_PLUS1 size 0x800 — TIMER_PLUS1 unit
0x40069000 RTC size 0x800 — RTC unit
0x4006A000 IWDT size 0x800 — IWDT unit
0x4006A800 WWDT size 0x800 — WWDT unit
0x4006B000 UART0 size 0x800 — UART0 unit
0x4006B800 UART1 size 0x800 — UART1 unit
0x4006C000 UART2 size 0x800 — UART2 unit
0x4006F000 FLASH_CTRL size 0x800 — FLASH_CTRL unit
0x400B0000 PORTCON size 0x800 — PORTCON unit
0x400B1000 PWM_BASE0 size 0x800 — PWM_BASE0 unit
0x400B1800 PWM_BASE1 size 0x800 — PWM_BASE1 unit
0x400B4000 PWM_PLUS0 size 0x800 — PWM_PLUS0 unit
0x400B4800 PWM_PLUS1 size 0x800 — PWM_PLUS1 unit
0x400B8000 SPI0 size 0x800 — SPI0 unit
0x400B8800 SPI1 size 0x800 — SPI1 unit
0x400B9000 IIC0 size 0x800 — IIC0 unit
0x400B9800 IIC1 size 0x800 — IIC1 unit
0x400BA000 SARADC size 0x800 — SARADC unit
0x400BD000 AES128 size 0x800 — AES128 unit

## SYSCON — System Configuration unit
Base 0x40000000
0x00 CLK_SEL reset 0x2 — Clock Select Register
0x04 DIV_CLK_GATE reset 0x1 — Divided Clock Gating Register
0x08 DEV_CLK_GATE — Peripheral Clock Gating Registers
0x78 RC_FREQ_DELTA — RCHF/RCLF True Frequency Value Difference Register
0x7C VREF_VOLT_DELTA — VREFTrue Voltage Difference Register
{0x80+4i} CHIP_ID{i} (i=0..3) — Equipment ID register {i}
0x180 PLL_CTRL reset 0x2C8 — PLL control register
0x184 PLL_ST — PLL status register

## PMU — Power management unit
Base 0x40000800
0x00 LPOW_MD — Low Power Mode Select Register
0x04 LPMD_WKEN — Low Power Wakeup Source Enable Register
0x08 LPMD_WKST — Low Power Wakeup Source Status Register
0x0C CHIP_RST_ST reset 0x1 — Chip Reset Status Register
0x10 SRC_CFG reset 0x3 — Clock Source Configuration Register
{0x20+4i} TRIM_POW{i} (i=0..3) — POW{i} Related Analog Modules TRIM register
0x30 TRIM_RCHF reset 0x808 — RCHFclock moduleTRIMregister
0x34 TRIM_RCLF reset 0x810 — RCLFclock moduleTRIMregister
0x38 TRIM_OPA — OPAmoduleTRIMregister
0x3C TRIM_PLL — PLLsmoduleTRIMregister
0x80 TRIM_LOCK
{0x100+4i} DATA_BAKE{i} (i=0..3) — Non-power-off domain data backup register{i}

## DMA — DMA unit
Base 0x40001000
0x00 DMA_CTR — DMAcontrol register
0x04 DMA_INTEN — DMAinterrupt enable register
0x08 DMA_INTST — DMAInterrupt Status Register
0x100 DMA_CH0CTR reset 0x1FFE — CH0 control register
0x104 DMA_CH0MOD — CH0 mode register
0x108 DMA_CH0MSADDR — CH0 source address register
0x10C DMA_CH0MDADDR — CH0 Destination Address Register
0x110 DMA_CH0_ST — CH0 status register
0x120 DMA_CH1CTR reset 0x1FFE — CH1 control register
0x124 DMA_CH1MOD — CH1 mode register
0x128 DMA_CH1MSADDR — CH1 source address register
0x12C DMA_CH1MDADDR — CH1 Destination Address Register

## CRC — Cyclic redundancy check calculation unit
Base 0x40003000
0x00 CRC_CR — CRC control register
0x04 CRC_IV — CRC initial value register
0x08 CRC_DATAIN — CRC input data register
0x0C CRC_DATAOUT — CRC output data register

## GPIOA — GPIOA unit
Base 0x40060000
0x00 GPIOA_DATA — GPIO DATA register
0x04 GPIOA_DIR — GPIO Pin direction
0x08 GPIOA_INTLVLTRG — GPIO Pin interrupt sensitive conditions
0x0C GPIOA_INTBE — GPIO Pin edge trigger mode
0x10 GPIOA_INTRISEEN — GPIO Pin interrupt event mode
0x14 GPIOA_INTEN — GPIO Pin interrupt enable
0x18 GPIOA_INTRAWSTAUS — Indicates that the corresponding bit is detectedGPIO interrupt trigger
0x1C GPIOA_INTSTAUS — Indicates that the corresponding bit is detectedGPIO pin generation int
0x20 GPIOA_INTCLR — Clear the corresponding bitGPIOsPin edge triggered interrupt flag

## GPIOB — GPIOB unit
Base 0x40060800
Registers as GPIOA (with GPIOA read as GPIOB).

## GPIOC — GPIOC unit
Base 0x40061000
Registers as GPIOA (with GPIOA read as GPIOC).
