# DP32G030 register map
File version: 1.0
CPU: CM0 r0p0, little endian, 4 interrupt priority bits
Registers are 32-bit, access not given, reset 0x0 unless marked. A register's access mark holds for its fields unless they carry their own. Offsets are from the block's base; [hi:lo] are bit positions.

## TIMER_BASE0 — TIMER_BASE0 unit
Base 0x40064000
0x00 TIMERBASE0_EN — TIMER enable register
0x04 TIMERBASE0_DIV — TIMER Count Clock Divider Register
0x10 TIMERBASE0_IE — TIMERinterrupt enable register
0x14 TIMERBASE0_IF — TIMER Interrupt Status Register
0x20 TIMERBASE0_HIGH_LOAD reset 0xFFFF — TIMER HIGH target configuration register
0x24 TIMERBASE0_HIGH_CNT — TIMER HIGH Current count value register
0x30 TIMERBASE0_LOW_LOAD reset 0xFFFF — TIMER LOW target configuration register
0x34 TIMERBASE0_LOW_CNT — TIMER LOW Current count value register

## TIMER_BASE1 — TIMER_BASE1 unit
Base 0x40064800
0x00 TIMERBASE1_EN — TIMER enable register
0x04 TIMERBASE1_DIV — TIMER Count Clock Divider Register
0x10 TIMERBASE1_IE — TIMERinterrupt enable register
0x14 TIMERBASE1_IF — TIMER Interrupt Status Register
0x20 TIMERBASE1_HIGH_LOAD reset 0xFFFF — TIMER HIGH target configuration register
0x24 TIMERBASE1_HIGH_CNT — TIMER HIGH Current count value register
0x30 TIMERBASE1_LOW_LOAD reset 0xFFFF — TIMER LOW target configuration register
0x34 TIMERBASE1_LOW_CNT — TIMER LOW Current count value register

## TIMER_BASE2 — TIMER_BASE2 unit
Base 0x40065000
0x00 TIMERBASE2_EN — TIMER enable register
0x04 TIMERBASE2_DIV — TIMER Count Clock Divider Register
0x10 TIMERBASE2_IE — TIMERinterrupt enable register
0x14 TIMERBASE2_IF — TIMER Interrupt Status Register
0x20 TIMERBASE2_HIGH_LOAD reset 0xFFFF — TIMER HIGH target configuration register
0x24 TIMERBASE2_HIGH_CNT — TIMER HIGH Current count value register
0x30 TIMERBASE2_LOW_LOAD reset 0xFFFF — TIMER LOW target configuration register
0x34 TIMERBASE2_LOW_CNT — TIMER LOW Current count value register

## TIMER_PLUS0 — TIMER_PLUS0 unit
Base 0x40067000
0x00 TIMERPLUS0_EN — TIMERPLUS enable register
0x04 TIMERPLUS0_DIV — TIMERPLUS Count Clock Prescaler Register
0x08 TIMERPLUS0_CTR reset 0x600060 — TIMERPLUS configuration register
0x10 TIMERPLUS0_IE — TIMERPLUS interrupt enable register
0x14 TIMERPLUS0_IF — TIMERPLUS Interrupt Status Register
0x20 TIMERPLUS0_HIGH_GOAL reset 0xFFFF — TIMERPLUS HIGH target configuration register
0x24 TIMERPLUS0_HIGH_CNT — TIMERPLUS HIGH Current count value register
0x28 TIMERPLUS0_HIGH_CVAL — TIMERPLUS HIGH capture value register
0x30 TIMERPLUS0_LOW_GOAL reset 0xFFFF — TIMERPLUS LOW target configuration register
0x34 TIMERPLUS0_LOW_CNT — TIMERPLUS LOW Current count value register
0x38 TIMERPLUS0_LOW_CVAL — TIMERPLUS HIGH capture value register
0x40 TIMERPLUS0_HALL_VAL — HALL Signal Raw Value Register

## TIMER_PLUS1 — TIMER_PLUS1 unit
Base 0x40067800
0x00 TIMERPLUS1_EN — TIMERPLUS enable register
0x04 TIMERPLUS1_DIV — TIMERPLUS Count Clock Prescaler Register
0x08 TIMERPLUS1_CTR reset 0x600060 — TIMERPLUS configuration register
0x10 TIMERPLUS1_IE — TIMERPLUS interrupt enable register
0x14 TIMERPLUS1_IF — TIMERPLUS Interrupt Status Register
0x20 TIMERPLUS1_HIGH_GOAL reset 0xFFFF — TIMERPLUS HIGH target configuration register
0x24 TIMERPLUS1_HIGH_CNT — TIMERPLUS HIGH Current count value register
0x28 TIMERPLUS1_HIGH_CVAL — TIMERPLUS HIGH capture value register
0x30 TIMERPLUS1_LOW_GOAL reset 0xFFFF — TIMERPLUS LOW target configuration register
0x34 TIMERPLUS1_LOW_CNT — TIMERPLUS LOW Current count value register
0x38 TIMERPLUS1_LOW_CVAL — TIMERPLUS HIGH capture value register
0x40 TIMERPLUS1_HALL_VAL — HALL Signal Raw Value Register

## RTC — RTC unit
Base 0x40069000
0x00 RTC_CFG — RTCconfiguration register
0x04 RTC_IE — RTC interrupt enable register
0x08 RTC_IF — RTC status register
0x10 RTC_PRE reset 0x7FFF — RTC prescaler register
0x14 RTC_TR — RTC time register
0x18 RTC_DR reset 0x101 — RTCdate register
0x1C RTC_AR — RTC alarm clock register
0x20 RTC_TSTR — RTC current time register
0x24 RTC_TSDR reset 0x101 — RTCcurrent date register
0x28 RTC_CNT — RTC current count value of the second scale
0x2C RTC_VALID — RTC Current Time Valid Flag Register
